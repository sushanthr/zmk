## app/boards/arm/nice_nano/Kconfig.defconfig
```kconfig
# Copyright (c) 2021 The ZMK Contributors
# SPDX-License-Identifier: MIT

if BOARD_NICE_NANO || BOARD_NICE_NANO_V2

  config BOARD
    default "nice_nano"

  if USB_DEVICE_STACK

    config USB_NRFX
      default y

  endif # USB_DEVICE_STACK

  config BT_CTLR
    default BT

  config ZMK_BLE
    default y

  config ZMK_USB
    default y

  # Role of the keyboard in split setup, default is master (i.e., central)
  ## NOTE: this is a dedicated config option for nrfmacro board, so that all shields
  ## using this board can share the some configuration. It's mainly used for controlling
  ## which widget to show on different side of the keyboard
  choice
    prompt "Role of the keyboard"
    help
      Specify the role of the keyboard

  config NICE_NANO_SHIELD_MASTER
    bool "master side, in charge of communication with host"

  config NICE_NANO_SHIELD_SLAVE
    bool "slave side, acting as a peripheral to master side"

  endchoice

  # add point device
  config NICE_NANO_POINTDEVICE
    bool "add support for point device"
    select SPI

endif # BOARD_NICE_NANO || BOARD_NICE_NANO_V2
```
